/*
 * Copyright (c) 2020 The ZMK Contributors
 *
 * SPDX-License-Identifier: MIT
 */

#include <behaviors.dtsi>
#include <behaviors/num_word.dtsi>
#include <behaviors/unicode.dtsi>
#include <dt-bindings/zmk/bt.h>
#include <dt-bindings/zmk/keys.h>
// #include <dt-bindings/zmk/pointing.h>
#include <dt-bindings/zmk/rgb.h>

#include "include/40.h"
#include "zmk-helpers/helper.h"
#include <zmk-unicode/keys.h>
#include <dt-bindings/zmk/outputs.h>

// Layers
#define COLEMAK 0
#define QUERTY 1
#define SYM 2
#define NUM 3
#define NAV 4
#define SYS 5
#define MOUSE 6
#define FN    7

// placeholders
#define XXX &none
#define ___ &trans

// Global configs
#define QUICK_TAP_MS 150
#define TAPPING_TERM_MS 280

#define KEYS_L LT0 LT1 LT2 LT3 LT4 LM0 LM1 LM2 LM3 LM4 LB0 LB1 LB2 LB3 LB4  // Left-hand keys.
#define KEYS_R RT0 RT1 RT2 RT3 RT4 RM0 RM1 RM2 RM3 RM4 RB0 RB1 RB2 RB3 RB4  // Right-hand keys.
#define THUMBS LH2 LH1 LH0 RH0 RH1 RH2                                      // Thumb keys.

#define RGB_COL_1 &rgb_ug RGB_COLOR_HSB(255,77,41)
#define RGB_COL_2 &rgb_ug RGB_COLOR_HSB(120,60,59)

&sk {
  release-after-ms = <900>;
  quick-release;
};

&sl { // Allow sticky mods to chord across sticky layers.
  ignore-modifiers;
};

&lt {
  flavor = "balanced";
  tapping-term-ms = <280>;
  quick-tap-ms = <QUICK_TAP_MS>;
};

// Homerow mods
#define MAKE_HRM(NAME, HOLD, TAP, TRIGGER_POS)                                 \
  ZMK_HOLD_TAP(NAME, bindings = <HOLD>, <TAP>; flavor = "balanced";            \
               tapping-term-ms = <TAPPING_TERM_MS>; quick-tap-ms = <QUICK_TAP_MS>;         \
               require-prior-idle-ms = <200>; hold-trigger-on-release;         \
               hold-trigger-key-positions = <TRIGGER_POS>;)

MAKE_HRM(hml, &kp, &kp, KEYS_R THUMBS) // Left-hand HRMs.
MAKE_HRM(hmr, &kp, &kp, KEYS_L THUMBS) // Right-hand HRMs.

// Hack: Make HRM combos tap-only (cf, ZMK issue #544).
#define ZMK_COMBO_8(NAME, TAP, POS, LAYERS, COMBO_MS, IDLE_MS, HOLD, SIDE)     \
  MAKE_HRM(hm_combo_##NAME, &kp, TAP, SIDE THUMBS)                             \
  ZMK_COMBO_6(NAME, &hm_combo_##NAME HOLD 0, POS, LAYERS, COMBO_MS, IDLE_MS)

// combos, mouse & leader sequences
#include "leader.dtsi"
#include "combos.dtsi"
#include "mouse.dtsi"

/* Nav cluster */

// Trigger tap-action on all interrupts.
#define MT_CORE                                                                \
  flavor = "tap-preferred";                                                    \
  tapping-term-ms = <220>;                                                     \
  quick-tap-ms = <220>;                                                        \
  hold-trigger-key-positions = <0>;

&mt { MT_CORE };

ZMK_HOLD_TAP(mt_home, bindings = <&masked_home>, <&kp>; MT_CORE)
ZMK_HOLD_TAP(mt_end, bindings = <&masked_end>, <&kp>; MT_CORE)

#define NAV_LEFT  &mt_home 0   LEFT  // Tap: left  | Long-tap: start of line.
#define NAV_RIGHT &mt_end 0    RIGHT // Tap: right | Long-tap: end   of line.
#define NAV_UP    &mt LC(HOME) UP    // Tap: up    | Long-tap: start of doc.
#define NAV_DOWN  &mt LC(END)  DOWN  // Tap: down  | Long-tap: end   of doc.
#define NAV_BSPC  &mt LC(BSPC) BSPC  // Tap: bspc  | Long-tap: delete word bwd.
#define NAV_DEL   &mt LC(DEL)  DEL   // Tap: del   | Long-tap: delete word fwd.

// Mask CTRL on left/right hold to avoid accidental jumps to start/end of doc.
#define MASK_MODS(NAME, MODS, BINDING)                                         \
  ZMK_MOD_MORPH(NAME, bindings = <BINDING>, <BINDING>; mods = <MODS>;)

MASK_MODS(masked_home, (MOD_LCTL), &kp HOME)
MASK_MODS(masked_end,  (MOD_LCTL), &kp END)

/* Magic-shift & auto-layers */

// Tap: repeat after alpha, else sticky-shift |
// Shift + tap/ double-tap: caps-word | Hold: shift.
#define MAGIC_SHIFT &magic_shift LSHFT 0
ZMK_HOLD_TAP(magic_shift, bindings = <&kp>, <&magic_shift_tap>;
             flavor = "balanced"; tapping-term-ms = <TAPPING_TERM_MS>;
             quick-tap-ms = <QUICK_TAP_MS>;)
ZMK_MOD_MORPH(magic_shift_tap, bindings = <&shift_repeat>, <&caps_word>;
              mods = <(MOD_LSFT)>;)
ZMK_ADAPTIVE_KEY(
    shift_repeat, bindings = <&sk LSHFT>;
    repeat {
      trigger-keys = <A B C D E F G H I J K L M N O P Q R S T U V W X Y Z>;
      bindings = <&key_repeat>;
      max-prior-idle-ms = <1200>;
      strict-modifiers;
    };)
&caps_word { // Mods deactivate caps-word, requires PR #1451. [TODO: rebase]
  /delete-property/ ignore-modifiers;
};

// Tap: num-word | double-tap: sticky num-layer | Hold: num-layer.
#define SMART_NUM &smart_num NUM 0
ZMK_HOLD_TAP(smart_num, bindings = <&mo>, <&num_dance>; flavor = "balanced";
             tapping-term-ms = <TAPPING_TERM_MS>; quick-tap-ms = <QUICK_TAP_MS>;)
ZMK_TAP_DANCE(num_dance, bindings = <&num_word NUM>, <&sl NUM>;
              tapping-term-ms = <TAPPING_TERM_MS>;)

// Smart-mouse, requires tri-state module.
ZMK_TRI_STATE(
    smart_mouse, bindings = <&tog MOUSE>, <&none>, <&tog MOUSE>;
    ignored-key-positions =
        <LT1 LT2 LH0 LH1 LH2 RT1 RT2 RT3 RM0 RM1 RM2 RM3 RM4 RB1 RB2 RB3 RH0 RH1 RH2>;
    ignored-layers = <MOUSE NAV NUM>;)

// Alt+Tab swapper, requires tri-state module.
ZMK_TRI_STATE(swapper, bindings = <&kt LALT>, <&kp TAB>, <&kt LALT>;
              ignored-key-positions = <LT2 RT2 RM1 RM2 RM3>;)

// Define mod-morph with a *single* mod trigger for less repetition.
#define SIMPLE_MORPH(NAME, MOD, BINDING1, BINDING2)                            \
  ZMK_MOD_MORPH(NAME, mods = <(MOD_L##MOD | MOD_R##MOD)>;                      \
                bindings = <BINDING1>, <BINDING2>;)

// Tap: space | Shift + tap: dot -> space -> sticky shift | Hold: nav layer.
ZMK_HOLD_TAP(lt_spc, bindings = <&mo>, <&spc_morph>; flavor = "balanced";
             tapping-term-ms = <TAPPING_TERM_MS>; quick-tap-ms = <QUICK_TAP_MS>;)
SIMPLE_MORPH(spc_morph, SFT, &kp SPACE, &dot_spc)
ZMK_MACRO(dot_spc, bindings = <&kp DOT &kp SPACE &sk LSHFT>; wait-ms = <0>;
          tap-ms = <5>;)

// Tap: sticky layer | Hold: momentary layer
ZMK_HOLD_TAP(mo_sl, bindings = <&mo>, <&sl>; flavor = "balanced";
             tapping-term-ms = <TAPPING_TERM_MS>; quick-tap-ms = <QUICK_TAP_MS>;)

// Tap: comma | Shift + tap: semicolon | Ctrl + shift + tap: <.
SIMPLE_MORPH(comma_morph, SFT, &kp COMMA, &comma_inner_morph)
SIMPLE_MORPH(comma_inner_morph, CTL, &kp SEMICOLON, &kp LESS_THAN)

// Tap: dot | Shift + tap: colon | Ctrl + shift + tap: > | Hold: RALT.
SIMPLE_MORPH(dot_inner_morph, CTL, &kp COLON, &kp GREATER_THAN)
SIMPLE_MORPH(dot_morph, SFT, &kp DOT, &dot_inner_morph)
ZMK_HOLD_TAP(dot_morph_hmr, bindings = <&kp>, <&dot_morph>; flavor = "balanced";
            tapping-term-ms = <TAPPING_TERM_MS>; quick-tap-ms = <QUICK_TAP_MS>;)
#define DOT_MORPH &dot_morph_hmr RALT 0

// Tap: qmark | Shift + tap: excl.
SIMPLE_MORPH(qexcl, SFT, &kp QMARK, &kp EXCL)

// Tap: left/right parenthesis | Shft + tap: less-than/greater-than.
SIMPLE_MORPH(lpar_lt, SFT, &kp LPAR, &kp LT)
SIMPLE_MORPH(rpar_gt, SFT, &kp RPAR, &kp GT)

// Tap: backspace | Lshft + tap: delete | Rshft + tap: shift-delete.
ZMK_MOD_MORPH(bs_del, bindings = <&kp BSPC>, <&kp DEL>;
             mods = <(MOD_LSFT|MOD_RSFT)>; keep-mods = <MOD_RSFT>;)

// Misc aliases.
#define CANCEL    &kp K_CANCEL            // Cancel caps-word & auto-layers.

// Tap: sticky FN layer | Double-tap: cancel caps-word & auto-layers | Hold: momentary FN layer.
ZMK_TAP_DANCE(fn_dance, bindings = <&sl FN>, <&kp K_CANCEL>;
              tapping-term-ms = <TAPPING_TERM_MS>;)
ZMK_HOLD_TAP(fn_mo, bindings = <&mo>, <&fn_dance>; flavor = "balanced";
             tapping-term-ms = <TAPPING_TERM_MS>; quick-tap-ms = <QUICK_TAP_MS>;)
#define FN_KEY    &fn_mo FN 0

// Sticky shift + leader.
ZMK_MACRO(leader_sft, bindings = <&sk LSHFT &leader>;)

/ {
    chosen { zmk,physical-layout = &five_col_layout; };
};

&uc { default-mode = <UC_MODE_LINUX>; };

ZMK_LAYER(Colemak,
    // ╭───────────────┬───────────────┬───────────────┬───────────────┬───────────────╮          ╭───────────────┬───────────────┬───────────────┬───────────────┬───────────────╮
         &kp Q           &kp W           &kp F           &kp P           &kp B           XXX  XXX   &kp J           &kp L           &kp U           &kp Y           &kp SQT        
    // ├───────────────┼───────────────┼───────────────┼───────────────┼───────────────┤          ├───────────────┼───────────────┼───────────────┼───────────────┼───────────────┤
         &hml LSHIFT A   &hml LALT R     &hml LGUI S     &hml LCTRL T    &kp G           XXX  XXX   &kp M           &hmr RCTRL N    &hmr RGUI E     &hmr LALT I     &hmr RSHIFT O
    // ├───────────────┼───────────────┼───────────────┼───────────────┼───────────────┤          ├───────────────┼───────────────┼───────────────┼───────────────┼───────────────┤
         &kp Z           &hml RALT X     &kp C           &kp D           &kp V                      &kp K           &kp H           &comma_morph    DOT_MORPH       &qexcl
    // ╰───────────────┴───────────────┴───────────────┼───────────────┼───────────────┤          ├───────────────┼───────────────┼───────────────┼───────────────┴───────────────╯
                                         SMART_NUM       MAGIC_SHIFT     &lt_spc NAV 0              &kp RET         &bs_del         FN_KEY
    //                                 ╰───────────────┴───────────────┴───────────────╯          ╰───────────────┴───────────────┴───────────────╯
)

ZMK_LAYER(Querty,
    // ╭───────────────┬───────────────┬───────────────┬───────────────┬───────────────╮          ╭───────────────┬───────────────┬───────────────┬───────────────┬───────────────╮
         &kp Q           &kp W           &kp E           &kp R           &kp T           XXX  XXX   &kp Y           &kp U           &kp I           &kp O           &kp P
    // ├───────────────┼───────────────┼───────────────┼───────────────┼───────────────┤          ├───────────────┼───────────────┼───────────────┼───────────────┼───────────────┤
         &hml LSHIFT A   &hml LALT S     &hml LGUI D     &hml LCTRL F    &kp G           XXX  XXX   &kp H           &hmr RCTRL J    &hmr RGUI K     &hmr LALT L     &hmr RSHIFT SQT
    // ├───────────────┼───────────────┼───────────────┼───────────────┼───────────────┤          ├───────────────┼───────────────┼───────────────┼───────────────┼───────────────┤
         &kp Z           &hml RALT X     &kp C           &kp V           &kp B                      &kp N           &kp M           &comma_morph    DOT_MORPH       &qexcl
    // ╰───────────────┴───────────────┴───────────────┼───────────────┼───────────────┤          ├───────────────┼───────────────┼───────────────┼───────────────┴───────────────╯
                                         SMART_NUM       MAGIC_SHIFT     &lt_spc NAV 0              &kp RET         &bs_del         FN_KEY
    //                                 ╰───────────────┴───────────────┴───────────────╯          ╰───────────────┴───────────────┴───────────────╯
)

ZMK_LAYER(Symbol,
    // ╭───────────────┬───────────────┬───────────────┬───────────────┬───────────────╮          ╭───────────────┬───────────────┬───────────────┬───────────────┬───────────────╮
         ___             ___             ___             ___             ___             XXX  XXX   ___             ___             ___             ___             ___
    // ├───────────────┼───────────────┼───────────────┼───────────────┼───────────────┤          ├───────────────┼───────────────┼───────────────┼───────────────┼───────────────┤
         ___             ___             ___             ___             ___             XXX  XXX   ___             ___             ___             ___             ___
    // ├───────────────┼───────────────┼───────────────┼───────────────┼───────────────┤          ├───────────────┼───────────────┼───────────────┼───────────────┼───────────────┤
         ___             ___             ___             ___             ___                        ___             ___             ___             ___             ___
    // ╰───────────────┴───────────────┴───────────────┼───────────────┼───────────────┤          ├───────────────┼───────────────┼───────────────┼───────────────┴───────────────╯
                                         ___             ___             ___                        ___             ___             ___
    //                                 ╰───────────────┴───────────────┴───────────────╯          ╰───────────────┴───────────────┴───────────────╯
)

ZMK_LAYER(Number,
    // ╭───────────────┬───────────────┬───────────────┬───────────────┬───────────────╮          ╭───────────────┬───────────────┬───────────────┬───────────────┬───────────────╮
         ___             ___             ___             ___             ___             XXX  XXX   ___             &kp N7          &kp N8          &kp N9          ___
    // ├───────────────┼───────────────┼───────────────┼───────────────┼───────────────┤          ├───────────────┼───────────────┼───────────────┼───────────────┼───────────────┤
         ___             ___             ___             ___             ___             XXX  XXX   &kp N0          &kp N4          &kp N5          &kp N6          ___
    // ├───────────────┼───────────────┼───────────────┼───────────────┼───────────────┤          ├───────────────┼───────────────┼───────────────┼───────────────┼───────────────┤
         ___             ___             ___             ___             ___                        ___             &kp N1          &kp N2          &kp N3          ___
    // ╰───────────────┴───────────────┴───────────────┼───────────────┼───────────────┤          ├───────────────┼───────────────┼───────────────┼───────────────┴───────────────╯
                                         ___             ___             ___                        ___             ___             ___
    //                                 ╰───────────────┴───────────────┴───────────────╯          ╰───────────────┴───────────────┴───────────────╯
)

ZMK_LAYER(Nav,
    // ╭───────────────┬───────────────┬───────────────┬───────────────┬───────────────╮          ╭───────────────┬───────────────┬───────────────┬───────────────┬───────────────╮
         ___             ___             &kp LS(TAB)     &swapper        ___             XXX  XXX   ___             NAV_BSPC        &kp INS         NAV_DEL         ___
    // ├───────────────┼───────────────┼───────────────┼───────────────┼───────────────┤          ├───────────────┼───────────────┼───────────────┼───────────────┼───────────────┤
         &sk LSHIFT      &sk LALT        &sk LGUI        &sk LCTRL       ___             XXX  XXX   ___             NAV_LEFT        NAV_DOWN        NAV_UP          NAV_RIGHT
    // ├───────────────┼───────────────┼───────────────┼───────────────┼───────────────┤          ├───────────────┼───────────────┼───────────────┼───────────────┼───────────────┤
         ___             ___             ___             ___             ___                        ___             &kp TAB         &kp PG_DN       &kp PG_UP       ___
    // ╰───────────────┴───────────────┴───────────────┼───────────────┼───────────────┤          ├───────────────┼───────────────┼───────────────┼───────────────┴───────────────╯
                                         ___             ___             ___                        ___             ___             FN_KEY
    //                                 ╰───────────────┴───────────────┴───────────────╯          ╰───────────────┴───────────────┴───────────────╯
)

ZMK_LAYER(System,
    // ╭───────────────┬───────────────┬───────────────┬───────────────┬───────────────╮          ╭───────────────┬───────────────┬───────────────┬───────────────┬───────────────╮
         &bt BT_SEL 0    &bt BT_SEL 1    &bt BT_SEL 2    &bt BT_SEL 3    &bt BT_SEL 4    XXX  XXX   ___             ___             &rgb_ug RGB_HUI &rgb_ug RGB_BRI ___
    // ├───────────────┼───────────────┼───────────────┼───────────────┼───────────────┤          ├───────────────┼───────────────┼───────────────┼───────────────┼───────────────┤
         &out OUT_TOG    ___             ___             ___             &bootloader     XXX  XXX   &bootloader     &rgb_ug RGB_TOG &rgb_ug RGB_HUD &rgb_ug RGB_BRD ___
    // ├───────────────┼───────────────┼───────────────┼───────────────┼───────────────┤          ├───────────────┼───────────────┼───────────────┼───────────────┼───────────────┤
         &bt BT_CLR_ALL  &bt BT_CLR      ___             ___             &sys_reset                 &sys_reset      ___             ___             ___             ___ 
    // ╰───────────────┴───────────────┴───────────────┼───────────────┼───────────────┤          ├───────────────┼───────────────┼───────────────┼───────────────┴───────────────╯
                                         &to COLEMAK     ___             ___                        ___             ___             ___
    //                                 ╰───────────────┴───────────────┴───────────────╯          ╰───────────────┴───────────────┴───────────────╯
)
        
ZMK_LAYER(Mouse,
    // ╭───────────────┬───────────────┬───────────────┬───────────────┬───────────────╮          ╭───────────────┬───────────────┬───────────────┬───────────────┬───────────────╮
         ___             ___             ___             ___             ___             XXX  XXX   ___             ___             &kp PG_DN       &kp PG_UP       ___
    // ├───────────────┼───────────────┼───────────────┼───────────────┼───────────────┤          ├───────────────┼───────────────┼───────────────┼───────────────┼───────────────┤
         ___             ___             ___             ___             ___             XXX  XXX   ___             U_MS_L          U_MS_D          U_MS_U          U_MS_R
    // ├───────────────┼───────────────┼───────────────┼───────────────┼───────────────┤          ├───────────────┼───────────────┼───────────────┼───────────────┼───────────────┤
         ___             ___             ___             ___             ___                        ___             U_WH_L          U_WH_U          U_WH_D          U_WH_R
    // ╰───────────────┴───────────────┴───────────────┼───────────────┼───────────────┤          ├───────────────┼───────────────┼───────────────┼───────────────┴───────────────╯
                                         ___             ___             ___                        &mkp LCLK       &mkp MCLK       &mkp RCLK
    //                                 ╰───────────────┴───────────────┴───────────────╯          ╰───────────────┴───────────────┴───────────────╯
)

ZMK_LAYER(Fn,
    // ╭───────────────┬───────────────┬───────────────┬───────────────┬───────────────╮          ╭───────────────┬───────────────┬───────────────┬───────────────┬───────────────╮
         ___             &kp F7          &kp F8          &kp F9          &kp F10         XXX  XXX   ___             ___             &bt BT_PRV      &bt BT_NXT      ___
    // ├───────────────┼───────────────┼───────────────┼───────────────┼───────────────┤          ├───────────────┼───────────────┼───────────────┼───────────────┼───────────────┤
         ___             &kp F4          &kp F5          &kp F6          &kp F11         XXX  XXX   ___             &kp K_MUTE      &kp C_VOL_DN    &kp C_VOL_UP    ___
    // ├───────────────┼───────────────┼───────────────┼───────────────┼───────────────┤          ├───────────────┼───────────────┼───────────────┼───────────────┼───────────────┤
         ___             &kp F1          &kp F2          &kp F3          &kp F12                    ___             ___             ___             ___             ___
    // ╰───────────────┴───────────────┴───────────────┼───────────────┼───────────────┤          ├───────────────┼───────────────┼───────────────┼───────────────┴───────────────╯
                                         &kp K_PREV     &kp K_PLAY_PAUSE &kp K_NEXT                 ___             ___             ___
    //                                 ╰───────────────┴───────────────┴───────────────╯          ╰───────────────┴───────────────┴───────────────╯
)