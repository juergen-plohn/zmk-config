// Leader key sequences.
// Usage: press LEADER (LM1 + LM2) or
// SHIFT + LEADER (LM1 + LM2 + LM3), then a combination of keys listed here.

// Define the leader behavior node (once, labeled for &leader references).
/ {
    behaviors {
        leader: leader {
            compatible = "zmk,behavior-leader-key";
            #binding-cells = <0>;
            ignore-keys = <LSHFT RSHFT LCTRL RCTRL LALT RALT LGUI RGUI>;
        };
    };
};

// Override ZMK_LEADER_SEQUENCE from zmk-helpers to use zmk-leader-key v0.3's
// child-node syntax (instead of the incompatible zmk,leader-sequences format).
#undef ZMK_LEADER_SEQUENCE
#define ZMK_LEADER_SEQUENCE(name, leader_bindings, leader_sequence) \
    / { \
        behaviors { \
            leader { \
                leader_sequence_ ## name { \
                    bindings = <leader_bindings>; \
                    sequence = <leader_sequence>; \
                }; \
            }; \
        }; \
    };

// Unicode constants (if not already provided by zmk-unicode module)
#define UC_EURO  0x20AC   // €
#define UC_SECT  0x00A7   // §

// Add leader sequences here, e.g.:
// ZMK_LEADER_SEQUENCE(name, mapping, sequence)
ZMK_LEADER_SEQUENCE(euro,       &uc UC_EURO,    E)          // leader → E  →  €
ZMK_LEADER_SEQUENCE(sect,       &uc UC_SECT,    P)          // leader → S  →  §

// SYSTEM commands
ZMK_LEADER_SEQUENCE(reset,      &sys_reset,     R E S E T)
ZMK_LEADER_SEQUENCE(boot,       &bootloader,    B O O T)

ZMK_LEADER_SEQUENCE(usb,        &out OUT_USB,   U S B)
ZMK_LEADER_SEQUENCE(ble,        &out OUT_BLE,   B L E)
